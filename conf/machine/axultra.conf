## conf/machine/axultra.conf
```bitbake
#@TYPE: Machine
#@NAME: axultra
#@DESCRIPTION: Machine configuration for the axultra

require conf/machine/include/hd-cortex-a15.inc

RCNAME = "ax51"

PREFERRED_PROVIDER_virtual/egl ?= "hd-v3ddriver-hd51" 
PREFERRED_PROVIDER_virtual/libgles2 ?= "hd-v3ddriver-hd51"

MACHINE_ESSENTIAL_EXTRA_RDEPENDS += "\
	hd-v3ddriver-hd51 \
	"

REFERRED_PROVIDER_virtual/kodi = "stb-kodi-hd51"

DISPLAY_BRAND = "AX 4K"
DISPLAY_MODEL = "HD51 ultra"
```

## conf/machine/bre2ze4k.conf
```bitbake
#@TYPE: Machine
#@NAME: wwio bre2ze4k
#@DESCRIPTION: Machine configuration for the bre2ze4k

RCTYPE = "23"
RCNAME = "wwio1"

require conf/machine/include/hd-cortex-a15.inc

PREFERRED_PROVIDER_virtual/egl ?= "hd-v3ddriver-hd51" 
PREFERRED_PROVIDER_virtual/libgles2 ?= "hd-v3ddriver-hd51"

MACHINE_ESSENTIAL_EXTRA_RDEPENDS += "\
	hd-v3ddriver-hd51 \
	"

REFERRED_PROVIDER_virtual/kodi = "stb-kodi-hd51"

DISPLAY_BRAND = "WWIO"
DISPLAY_MODEL = "BRE2ZE 4K"
```

## conf/machine/hd1500.conf
```bitbake
#@TYPE: Machine
#@NAME: hd1500
#@DESCRIPTION: Machine configuration for the hd1500

MKUBIFS_ARGS = "-m 2048 -e 126976 -c 8192"
UBINIZE_ARGS = "-m 2048 -p 128KiB"

MACHINE_FEATURES += "textlcd 7segment h265 ci"

SOC_FAMILY = "bcm73625"

require conf/machine/include/hd-mipsel.inc
```

## conf/machine/hd2400.conf
```bitbake
#@TYPE: Machine
#@NAME: hd2400
#@DESCRIPTION: Machine configuration for the hd2400

MACHINE_FEATURES += "dvb-c multitranscoding ci fanctrl bwlcd255 SCART YUV RCA HDMI-IN-HD kodi19"

MKUBIFS_ARGS = "-m 2048 -e 126976 -c 8192"
UBINIZE_ARGS = "-m 2048 -p 128KiB"

SOC_FAMILY = "bcm7425"

RCTYPE = "19"
RCNAME = "hd2400"

require conf/machine/include/hd-mipsel.inc

PREFERRED_PROVIDER_virtual/egl ?= "hd-v3ddriver-${MACHINE}" 
PREFERRED_PROVIDER_virtual/libgles2 ?= "hd-v3ddriver-${MACHINE}"

MACHINE_ESSENTIAL_EXTRA_RDEPENDS += "\
	hd-v3ddriver-${MACHINE} \
	"
```

## conf/machine/hd500c.conf
```bitbake
#@TYPE: Machine
#@NAME: hd500c
#@DESCRIPTION: Machine configuration for the hd500c

MKUBIFS_ARGS = "-m 2048 -e 126976 -c 4096"
UBINIZE_ARGS = "-m 2048 -p 128KiB"

MACHINE_FEATURES += "textlcd 7segment dvb-c nofhdskin RCA"

FLASHSIZE = "128"

SOC_FAMILY = "bcm7581"

require conf/machine/include/hd-mipsel.inc
```

## conf/machine/hd51.conf
```bitbake
#@TYPE: Machine
#@NAME: hd51
#@DESCRIPTION: Machine configuration for the hd51

MACHINE_FEATURES += "AV_JACK"

require conf/machine/include/hd-cortex-a15.inc

IMAGE_ROOTFS_SIZE = "236608"

PREFERRED_PROVIDER_virtual/egl = "hd-v3ddriver-${MACHINE}" 
PREFERRED_PROVIDER_virtual/libgles2 = "hd-v3ddriver-${MACHINE}"

MACHINE_ESSENTIAL_EXTRA_RDEPENDS += "\
	hd-v3ddriver-${MACHINE} \
	"
```

## conf/machine/hd530c.conf
```bitbake
#@TYPE: Machine
#@NAME: hd530c
#@DESCRIPTION: Machine configuration for the hd530c

MKUBIFS_ARGS = "-m 2048 -e 126976 -c 8192"
UBINIZE_ARGS = "-m 2048 -p 128KiB"

MACHINE_FEATURES += "textlcd 7segment dvb-c h265 AV_JACK"

FLASHSIZE = "128"

SOC_FAMILY = "bcm75839"

require conf/machine/include/hd-mipsel.inc

RCNAME = "hd530c"
```

## conf/machine/hd60.conf
```bitbake
#@TYPE: Machine
#@NAME: hd60
#@DESCRIPTION: Machine configuration for the hd60

MACHINE_FEATURES += "AV_JACK"

require conf/machine/include/hd-hi3798mv.inc

MTD_KERNEL = "mmcblk0p19"
MTD_ROOTFS = "mmcblk0p20"

RCTYPE = "27"
RCNAME = "hd60"
```

## conf/machine/hd61.conf
```bitbake
#@TYPE: Machine
#@NAME: hd61
#@DESCRIPTION: Machine configuration for the hd61

MACHINE_FEATURES += "ci dvb-c"

require conf/machine/include/hd-hi3798mv.inc

MTD_KERNEL = "mmcblk0p20"
MTD_ROOTFS = "mmcblk0p21"

RCTYPE = "26"
RCNAME = "ax4"
```

## conf/machine/include/hd-cortex-a15.inc
```bitbake
KERNELVERSION = "4.10.12"

PREFERRED_VERSION_linux-hd = "${KERNELVERSION}"

IMAGE_CLASSES += "hd-emmc_image_multiboot"
IMAGE_FSTYPES += "hdemmc tar"
IMAGE_ROOTFS_SIZE ?= "589824"

TARGET_ARCH = "arm"
DEFAULTTUNE = "cortexa15hf-neon-vfpv4"

require conf/machine/include/tune-cortexa15.inc
require conf/machine/include/hd.inc

MACHINE_FEATURES += "textlcd emmc ci mountboot swap"

SOC_FAMILY = "bcm7251s"

MTD_KERNEL = "mmcblk0p2"
MTD_ROOTFS = "mmcblk0p3"

MTD_BOOTFS = "mmcblk0p1"
KERNEL_FILE = "kernel.bin"
ROOTFS_FILE = "rootfs.tar.bz2"
MTD_BLACK  = "mmcblk0"

MACHINE_ESSENTIAL_EXTRA_RDEPENDS += "\
	 ${@bb.utils.contains('MACHINE_FEATURES', 'swap', 'hd-swapcreate', '',d)} \
	"

STB_PLATFORM = "gfuturesbcmarm"

IMAGE_CMD_hdemmc_append = "\
	mkdir -p ${IMGDEPLOYDIR}/${IMAGEDIR}; \
	cp -f ${IMGDEPLOYDIR}/${IMAGE_NAME}.emmc.img ${IMGDEPLOYDIR}/${IMAGEDIR}/disk.img; \
	echo "${IMAGE_NAME}" > ${IMGDEPLOYDIR}/${IMAGEDIR}/imageversion; \
	echo "https://forum.openvision.tech/app.php/donate" > ${IMGDEPLOYDIR}/${IMAGEDIR}/donate.txt; \
	cp -f ${DEPLOY_DIR_IMAGE}/zImage ${IMGDEPLOYDIR}/${IMAGEDIR}/${KERNEL_FILE}; \
	cp -f ${IMGDEPLOYDIR}/${IMAGE_NAME}${IMAGE_NAME_SUFFIX}.tar ${IMGDEPLOYDIR}/${IMAGEDIR}/rootfs.tar; \
	bzip2 ${IMGDEPLOYDIR}/${IMAGEDIR}/rootfs.tar; \
	rm -f ${IMGDEPLOYDIR}/*.zip; \
	cd ${IMGDEPLOYDIR}; \
	zip ${IMAGE_NAME}_recovery_emmc.zip ${IMAGEDIR}/disk.img ${IMAGEDIR}/imageversion ${IMAGEDIR}/donate.txt; \
	zip ${IMAGE_NAME}_usb.zip ${IMAGEDIR}/imageversion ${IMAGEDIR}/donate.txt ${IMAGEDIR}/${KERNEL_FILE} ${IMAGEDIR}/${ROOTFS_FILE}; \
	rm -f ${DEPLOY_DIR_IMAGE}/*.ext4; \
	rm -Rf ${IMAGEDIR}; \
	"

IMAGE_CMD_prepend = "\
	rm -Rf ${IMAGE_ROOTFS}/tmp/*; \
	"

DVBMEDIASINK_CONFIG = "--with-wma --with-wmv --with-pcm --with-dts --with-eac3 --with-h265 --with-vb6 --with-vb8 --with-vb9 --with-spark"
```

## conf/machine/include/hd-essential.inc
```bitbake
DISTRO_FEATURES_remove += "x11 wayland"

MACHINE_ESSENTIAL_EXTRA_RDEPENDS += "\
	hd-dvb-modules-${MACHINE} \
	${@bb.utils.contains("MACHINE_FEATURES", "emmc", "hd-resizerootfs partitions-by-name" , "", d)} \
	"

BOX_BRAND = "gfutures"

DISPLAY_BRAND ?= "Mut@nt"
```

## conf/machine/include/hd-hi3798mv.inc
```bitbake
DISTRO_FEATURES_append = " opengl"

KERNELVERSION = "4.4.35"

# We know about rtc
MACHINE_FEATURES_BACKFILL_CONSIDERED += "rtc"

TARGET_ARCH = "arm"
DEFAULTTUNE = "cortexa15hf-neon-vfpv4"

IMAGE_CLASSES += "hd-fastboot8gb_image"
IMAGE_FSTYPES += "hdfastboot8gb"
CMDLINE ?= "console=ttyAMA0,115200n8"

SOC_FAMILY = "hisi3798mv200"
HICHIPSET = "3798mv200"
CHIPSET = "Hi3798Mv200"

KERNEL_FILE = "uImage"
ROOTFS_FILE = "rootfs.tar.bz2"
MTD_BOOTFS = "mmcblk0p4"
MTD_BLACK  = "mmcblk0"

PREFERRED_VERSION_linux-hd = "${KERNELVERSION}"

#Provider
PREFERRED_PROVIDER_virtual/kernel = "linux-hd"
PREFERRED_PROVIDER_virtual/egl ?= "hd-mali-${MACHINE}"
PREFERRED_PROVIDER_virtual/libgles1 ?= "hd-mali-${MACHINE}"
PREFERRED_PROVIDER_virtual/libgles2 ?= "hd-mali-${MACHINE}"
PREFERRED_PROVIDER_virtual/libgbm ?= "hd-mali-${MACHINE}"
PREFERRED_PROVIDER_virtual/libgl ?= "mesa"
PREFERRED_PROVIDER_virtual/mesa ?= "mesa"
PREFERRED_PROVIDER_virtual/blindscan-dvbs = "hd-dvb-modules-${MACHINE}"
PREFERRED_PROVIDER_virtual/blindscan-dvbc = "hd-dvb-modules-${MACHINE}"
PREFERRED_PROVIDER_virtual/gstreamer1.0-dvbmediasink = "gstreamer1.0-plugin-dvbmediasink"
PREFERRED_PROVIDER_virtual/enigma2-mediaservice = "enigma2-plugin-systemplugins-servicehisilicon"

require conf/machine/include/tune-cortexa15.inc
require conf/machine/include/hd-essential.inc

# E2 OSD settings
EXTRA_OECONF_append_pn-enigma2 = " --with-alphablendingacceleration=always --with-blitaccelerationthreshold=250 --with-fillaccelerationthreshold=190000"

# Gstreamer dvbmediasink
DVBMEDIASINK_CONFIG = "--with-wma --with-wmv --with-pcm --with-dts --with-eac3 --with-h265 --with-vb6 --with-vb8 --with-vb9 --with-spark"

MACHINE_FEATURES += "alsa usbhost switchoff osdposition hdmicec textlcd 7segment blindscan-dvbs blindscan-tbs hisil mali transcoding emmc hisil-recovery mountboot fastboot multitranscoding wol HDMI"

MACHINE_ESSENTIAL_EXTRA_RDEPENDS += "\
	${@bb.utils.contains("MACHINE_FEATURES", "hisil", "hd-libs-${HICHIPSET} hd-partitions-${MACHINE} hd-bootargs-${MACHINE}" , "", d)} \
	${@bb.utils.contains("MACHINE_FEATURES", "hisil-recovery", "hd-recovery-${MACHINE}" , "", d)} \
	${@bb.utils.contains("MACHINE_FEATURES", "wol", "hd-ethwol" , "", d)} \
	${@bb.utils.contains("MACHINE_FEATURES", "mali", "hd-mali-${MACHINE} kernel-module-mali-${HICHIPSET}" , "", d)} \
	"

IMAGEDIR = "hd"

IMAGE_CMD_hdfastboot8gb_append = " \
	mkdir -p ${IMGDEPLOYDIR}/${IMAGEDIR}/${MACHINE}; \
	mkdir -p ${IMGDEPLOYDIR}/${IMAGEDIRRECOVERY}/${MACHINE}; \
	bzip2 ${IMGDEPLOYDIR}/${IMAGE_NAME}${IMAGE_NAME_SUFFIX}.tar; \
	cp -f ${DEPLOY_DIR_IMAGE}/uImage ${IMGDEPLOYDIR}/${IMAGEDIR}/${MACHINE}/uImage; \
	cp -f ${IMGDEPLOYDIR}/${IMAGE_NAME}${IMAGE_NAME_SUFFIX}.tar.bz2 ${IMGDEPLOYDIR}/${IMAGEDIR}/${MACHINE}/rootfs.tar.bz2; \
	echo "${IMAGE_NAME}" > ${IMGDEPLOYDIR}/${IMAGEDIR}/${MACHINE}/imageversion; \
	echo "https://forum.openvision.tech/app.php/donate" > ${IMGDEPLOYDIR}/${IMAGEDIR}/${MACHINE}/donate.txt; \
	echo "${IMAGE_NAME}_usb.zip" > ${IMGDEPLOYDIR}/${IMAGEDIR}/unforce_${MACHINE}.txt; \
	echo "Rename the unforce_${MACHINE}.txt to force_${MACHINE}.txt and move it to the root of your usb-stick" > ${IMGDEPLOYDIR}/${IMAGEDIR}/force_${MACHINE}_READ.ME; \
	echo "When you enter the recovery menu then it will force to install the image ${IMAGE_NAME}_usb.zip in the image-slot1" >> ${IMGDEPLOYDIR}/${IMAGEDIR}/force_${MACHINE}_READ.ME; \
	cp -f ${IMGDEPLOYDIR}/bootoptions.img ${IMGDEPLOYDIR}/${IMAGEDIRRECOVERY}/${MACHINE}/bootoptions.img; \
	cp -f ${DEPLOY_DIR_IMAGE}/hd-partitions-${MACHINE}/fastboot.bin ${IMGDEPLOYDIR}/${IMAGEDIRRECOVERY}/fastboot.bin; \
	cp -f ${DEPLOY_DIR_IMAGE}/hd-partitions-${MACHINE}/bootargs-8gb.bin ${IMGDEPLOYDIR}/${IMAGEDIRRECOVERY}/bootargs.bin; \
	cp -f ${DEPLOY_DIR_IMAGE}/hd-partitions-${MACHINE}/${MACHINE}/fastboot.bin ${IMGDEPLOYDIR}/${IMAGEDIRRECOVERY}/${MACHINE}/fastboot.bin; \
	cp -f ${DEPLOY_DIR_IMAGE}/hd-partitions-${MACHINE}/${MACHINE}/bootargs-8gb.bin ${IMGDEPLOYDIR}/${IMAGEDIRRECOVERY}/${MACHINE}/bootargs.bin; \
	cp -f ${DEPLOY_DIR_IMAGE}/hd-partitions-${MACHINE}/${MACHINE}/pq_param.bin ${IMGDEPLOYDIR}/${IMAGEDIRRECOVERY}/${MACHINE}/pqparam.bin; \
	cp -f ${DEPLOY_DIR_IMAGE}/hd-partitions-${MACHINE}/${MACHINE}/baseparam.img ${IMGDEPLOYDIR}/${IMAGEDIRRECOVERY}/${MACHINE}/baseparam.img; \
	cp -f ${DEPLOY_DIR_IMAGE}/hd-partitions-${MACHINE}/${MACHINE}/logo.img ${IMGDEPLOYDIR}/${IMAGEDIRRECOVERY}/${MACHINE}/logo.img; \
	cp -f ${DEPLOY_DIR_IMAGE}/hd-partitions-${MACHINE}/${MACHINE}/recovery.bin ${IMGDEPLOYDIR}/${IMAGEDIRRECOVERY}/${MACHINE}/recovery.bin; \
	echo "${MACHINE}-${DATE}-RECOVERY" > ${IMGDEPLOYDIR}/${IMAGEDIRRECOVERY}/${MACHINE}/recoveryversion; \
	echo "***** ATTENTION *****" >${IMGDEPLOYDIR}/${IMAGEDIRRECOVERY}/recovery_${MACHINE}_READ.ME; \
	echo "This RECOVERY only need when you have issue access the MULTIBOOT MENU" >>${IMGDEPLOYDIR}/${IMAGEDIRRECOVERY}/recovery_${MACHINE}_READ.ME; \
	echo "The ${IMAGE_NAME}_recovery_usb.zip should been install normally once (or if there is an update.)" >>${IMGDEPLOYDIR}/${IMAGEDIRRECOVERY}/recovery_${MACHINE}_READ.ME; \
	echo "This is needed for avoid images conflicts as the partition layout (bootargs) is of huge essential." >>${IMGDEPLOYDIR}/${IMAGEDIRRECOVERY}/recovery_${MACHINE}_READ.ME; \
	echo "A small change can destroy all your install images. So we can better leave it and not install it if it's not need." >>${IMGDEPLOYDIR}/${IMAGEDIRRECOVERY}/recovery_${MACHINE}_READ.ME; \
	rm -f ${IMGDEPLOYDIR}/*.zip; \
	cd ${IMGDEPLOYDIR}/${IMAGEDIRRECOVERY}; \
	zip -r ../${IMAGE_NAME}_recovery_emmc.zip *; \
	cd ..; \
	rm -Rf ${IMAGEDIRRECOVERY}; \
	cd ${IMGDEPLOYDIR}/${IMAGEDIR}; \
	zip -r ../${IMAGE_NAME}_usb.zip unforce_${MACHINE}.txt force_${MACHINE}_READ.ME ${MACHINE}/imageversion ${MACHINE}/donate.txt ${MACHINE}/uImage ${MACHINE}/rootfs.tar.bz2; \
	cd ..; \
	rm -Rf ${IMAGEDIR}; \
	"

IMAGE_CMD_prepend = "\
	rm -Rf ${IMAGE_ROOTFS}/tmp/*; \
	"

STB_PLATFORM = "gfutureshisil"

EXTRA_ALSA = "mv200"
```

## conf/machine/include/hd-mipsel.inc
```bitbake
KERNELVERSION = "4.10.12"

MTD_KERNEL = "mtd1"
MTD_ROOTFS = "mtd2"
KERNEL_FILE = "kernel.bin"
ROOTFS_FILE = "rootfs.bin"

PREFERRED_VERSION_linux-hd = "${KERNELVERSION}"

IMAGE_FSTYPES += "ubi"

TARGET_ARCH = "mipsel"
DEFAULTTUNE = "mips32el"

require conf/machine/include/tune-mips32.inc
require conf/machine/include/hd.inc

IMAGE_CMD_ubi_append = " \
	mkdir -p ${IMGDEPLOYDIR}/${IMAGEDIR}; \
	cp -f ${IMGDEPLOYDIR}/${IMAGE_NAME}${IMAGE_NAME_SUFFIX}.ubi ${IMGDEPLOYDIR}/${IMAGEDIR}/${ROOTFS_FILE}; \
	cp -f ${DEPLOY_DIR_IMAGE}/vmlinux.gz-${MACHINE}.bin ${IMGDEPLOYDIR}/${IMAGEDIR}/${KERNEL_FILE}; \
	echo "${IMAGE_NAME}" > ${IMGDEPLOYDIR}/${IMAGEDIR}/imageversion; \
	echo "https://forum.openvision.tech/app.php/donate" > ${IMGDEPLOYDIR}/${IMAGEDIR}/donate.txt; \
	echo "rename this file to 'force' to force an update without confirmation" > ${IMGDEPLOYDIR}/${IMAGEDIR}/noforce; \
	rm -f ${IMGDEPLOYDIR}/*.zip; \
	cd ${IMGDEPLOYDIR}; \
	zip ${IMAGE_NAME}_usb.zip ${IMAGEDIR}/*; \
	rm -f ${DEPLOY_DIR_IMAGE}/*.ubi; \
	rm -f ${DEPLOY_DIR_IMAGE}/*.ubifs; \
	rm -Rf ${IMGDEPLOYDIR}/boot; \
	rm -Rf ${IMAGEDIR}; \
	"

IMAGE_CMD_ubifs_prepend = " \
	rm -Rf ${IMAGE_ROOTFS}/tmp/*; \
	"

DVBMEDIASINK_CONFIG = "--with-wma --with-wmv --with-pcm --with-dts --with-eac3 \
	${@bb.utils.contains('MACHINE_FEATURES', 'h265', '--with-h265 --with-vb6 --with-vb8 --with-spark' , '', d)} \
	"

MACHINE_FEATURES += "videoenhancement"
```

## conf/machine/include/hd.inc
```bitbake
require conf/machine/include/hd-essential.inc

# We know about rtc
MACHINE_FEATURES_BACKFILL_CONSIDERED += "rtc"

#Provider
PREFERRED_PROVIDER_virtual/libgl ?= "mesa"
PREFERRED_PROVIDER_virtual/mesa ?= "mesa"
PREFERRED_PROVIDER_virtual/kernel = "linux-hd"

MACHINE_FEATURES += "alsa hdmicec usbhost switchoff osdposition blindscan-tbs HDMI"

MACHINE_ESSENTIAL_EXTRA_RDEPENDS += "\
	"

RCTYPE ?= "16"
RCNAME ?= "hd1100"
```

## conf/machine/vs1500.conf
```bitbake
#@TYPE: Machine
#@NAME: vs1500
#@DESCRIPTION: Machine configuration for the vs1500

MACHINE_FEATURES += "dvb-c"

require conf/machine/include/hd-cortex-a15.inc

PREFERRED_PROVIDER_virtual/egl = "hd-v3ddriver-${MACHINE}" 
PREFERRED_PROVIDER_virtual/libgles2 = "hd-v3ddriver-${MACHINE}"

MACHINE_ESSENTIAL_EXTRA_RDEPENDS += "\
	hd-v3ddriver-${MACHINE} \
	"

DISPLAY_BRAND = "Vimastec"
```
